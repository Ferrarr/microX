OUTPUT_ARCH("riscv")
ENTRY(_entry)

SECTIONS
{
    /* OpenSBI handoff starting point */
    . = 0x80200000;

    .text : {
        *(.text.entry)
        *(.text .text.*)
    }

    .rodata : {
        *(.rodata .rodata.*)
    }

    .data : {
        *(.data .data.*)
    }

    .bss : {
        __bss_start = .;
        *(.bss .bss.*)
        *(COMMON)
        __bss_end = .;
    }

    . = ALIGN(16);
    . += 0x10000;   /* 64 KiB reserved for stack */
    __stack_top = .;
}
